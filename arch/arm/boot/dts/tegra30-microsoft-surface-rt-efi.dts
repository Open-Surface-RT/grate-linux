/*
 * Temporary Microsoft Surface RT device-tree for EFI booting.
 */

/ {
	compatible = "microsoft,surface-rt-efi", "microsoft,surface-rt", "nvidia,tegra30";


	firmware {
		trusted-foundations {
			compatible = "tlm,trusted-foundations";
			tlm,version-major = <0x0>;
			tlm,version-minor = <0x0>;
			tlm,microsoft-surface-rt;
		};
	};
};

&tegra_pmc {
	/* CPU Idle does not work yet, disabling LP2 */
	/delete-property/ nvidia,suspend-mode;
};
